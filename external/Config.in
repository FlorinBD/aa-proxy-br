## external/Config.in
```kconfig
config BR2_CCACHE
	bool "Enable compiler cache"
	help
	  This option will enable the use of ccache, a compiler
	  cache. It will cache the result of previous builds to speed
	  up future builds. The cache is stored in
	  $HOME/.buildroot-ccache.

	  Note that Buildroot does not try to invalidate the cache
	  contents when the compiler changes in an incompatible
	  way. Therefore, if you make a change to the compiler version
	  and/or configuration, you are responsible for purging the
	  ccache cache by removing the $HOME/.buildroot-ccache
	  directory.

config BR2_CCACHE_DIR
	string "Compiler cache location"
	depends on BR2_CCACHE
	default "$(HOME)/.buildroot-ccache"
	help
	  Where ccache should store cached files.
    
source "$BR2_EXTERNAL_AA_PROXY_OS_PATH/package/Config.in"
source "$BR2_EXTERNAL_AA_PROXY_OS_PATH/boot/Config.in"
```

## external/package/aa-mirror-rs/Config.in
```kconfig
config BR2_PACKAGE_AA_MIRROR_RS
	bool "aa-mirror-rs"
	depends on BR2_PACKAGE_HOST_RUSTC_TARGET_ARCH_SUPPORTS
	select BR2_PACKAGE_HOST_RUSTC
	help
	  AndroidAuto wired/wireless mirroring service
```
